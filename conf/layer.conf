## conf/layer.conf
```bitbake
BBPATH .= ":${LAYERDIR}"
BBFILES += "${LAYERDIR}/recipes-*/*/*.bb \
            ${LAYERDIR}/recipes-*/*/*.bbappend"
BBFILE_COLLECTIONS += "llama"
BBFILE_PATTERN_llama = "^${LAYERDIR}/"
BBFILE_PRIORITY_llama = "6"
LAYERSERIES_COMPAT_llama = "scarthgap walnascar"
```
